## arch/arm64/configs/samsung/a11q/sdm450_sec_a11q_ltn_open_defconfig
```kconfig
CONFIG_SEC_A11Q_PROJECT=y
CONFIG_MACH_A11Q_LTN_OPEN=y
CONFIG_CRYPTO_ZSTD=y
CONFIG_VMPRESSURE_LEVEL_MED=70

#SS Sensor Factory feature
CONFIG_ADSP_FACTORY=y
CONFIG_SX93XX_FACTORY=y
```
